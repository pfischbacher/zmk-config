## config/boards/shields/lokiboard/Kconfig.shield
```kconfig
# Copyright (c) 2020 Pete Johanson
# SPDX-License-Identifier: MIT

config SHIELD_LOKIBOARD_LEFT
    def_bool $(shields_list_contains,lokiboard_left)

config SHIELD_LOKIBOARD_RIGHT
    def_bool $(shields_list_contains,lokiboard_right)
```

## config/west.yml
```yaml
manifest:
  remotes:
    - name: zmkfirmware
      url-base: https://github.com/zmkfirmware
  projects:
    - name: zmk
      remote: zmkfirmware
      revision: main
      import: app/west.yml
    - name: zmk-nice-nano
      remote: zmkfirmware
      revision: main
      path: modules/hardware/nice-nano
  self:
    path: config
```
